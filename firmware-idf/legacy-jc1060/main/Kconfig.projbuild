## firmware-idf/legacy-jc1060/main/Kconfig.projbuild
```kconfig
config RUZINA_MEMORY_TASK
    bool "Isolated legacy memory/task experiment"
    default n

config RUZINA_DISPLAY_TOUCH
    bool "Isolated JC1060 New_Panel display/touch diagnostic"
    default n

config RUZINA_SD_READONLY
    bool "Isolated read-only SD/exFAT diagnostic"
    default n

config RUZINA_SD_FIXTURE
    bool "Verify deterministic read-only file/seek fixture repeatedly"
    depends on RUZINA_SD_READONLY
    default n

config RUZINA_SD_RUST_BRIDGE
    bool "Isolated IDF-owned SD transport for shared Rust block client"
    default n

config RUZINA_SD_RUST_EXFAT
    bool "Verify fixture through shared Rust partition/exFAT reader"
    depends on RUZINA_SD_RUST_BRIDGE
    default n

config RUZINA_SD_RUST_LOAD
    bool "Import export.pdb and preflight every track through shared Rust media load"
    depends on RUZINA_SD_RUST_BRIDGE && SPIRAM && !RUZINA_SD_RUST_EXFAT
    default n

config RUZINA_USB_HOST_ENUM
    bool "Isolated USB host enumeration diagnostic on the HS port"
    default n

config RUZINA_USB_HOST_MIDI
    bool "Claim the USB-MIDI interface and feed the Rust controller session"
    depends on RUZINA_USB_HOST_ENUM
    default n

config RUZINA_USB_HOST_UAC
    bool "Stream a diagnostic headphone tone to the controller over UAC1"
    depends on RUZINA_USB_HOST_MIDI
    default n

config RUZINA_DECK_PLAY
    bool "Play deck 1's loaded track from the card to the controller headphones"
    depends on RUZINA_USB_HOST_UAC && RUZINA_LOAD_DISPLAY
    default n

config RUZINA_DECK_MIX
    bool "Mix both decks through the product render graph to MAIN and the headphones"
    depends on RUZINA_DECK_PLAY
    default n

config RUZINA_DECK_ENGINE
    bool "Run the product deck engine: CUE point, seek, pitch and jog on both decks"
    depends on RUZINA_DECK_MIX
    default n

config RUZINA_SLINT_UI
    bool "Measure the product Slint UI on the panel, instead of the status screen"
    depends on RUZINA_DECK_ENGINE
    default n

config RUZINA_LOAD_DISPLAY
    bool "Show the media load status on the New_Panel, with touch track selection"
    depends on RUZINA_SD_RUST_LOAD && !RUZINA_DISPLAY_TOUCH
    default n

config RUZINA_UAC_PROFILE
    bool "Diagnostic UAC callback substages and scheduler trace intervals"
    depends on RUZINA_DECK_ENGINE && !FREERTOS_SMP && !ESP_TRACE_ENABLE && !SECURE_ENABLE_TEE
    select ESP_TIMER_IN_IRAM
    default n

config RUZINA_MEDIA_USB_STICK
    bool "Read the media from a USB stick on the FS port instead of the SD card"
    depends on RUZINA_SD_RUST_BRIDGE && RUZINA_USB_HOST_ENUM
    default n
    help
        The USB host runs on both ports: the controller on HS, a mass-storage stick
        on FS. The FS PHY then leaves USB Serial/JTAG, so the console must be on
        UART0, and the board must not be powered from a PC on the FS port.

config RUZINA_PRODUCER_PROFILE
    bool "Diagnostic producer wall partitions and USB service observations"
    depends on RUZINA_DECK_ENGINE && !RUZINA_UAC_PROFILE
    default n
```
